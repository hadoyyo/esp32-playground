#include <WiFi.h>
#include <HTTPClient.h>
#include <TFT_eSPI.h>
#include <TJpg_Decoder.h>

#define BUF 40000
#define PIR_PIN 14
#define SWITCH_PIN 13
#define HEADER_H 30

static const unsigned char PROGMEM paused[] = {0xe7,0xe7,0xe7,0xe7,0xe7,0xe7,0xe7,0xe7,0xe7,0xe7,0xe7,0xe7};
static const unsigned char PROGMEM motion_sensor[] = {0x00,0x00,0x3c,0x00,0x00,0x00,0x00,0x00,0x00,0x7e,0x00,0x00,0x00,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0x00,0x00};


const char* ssid = "ssid";
const char* password = "password";
const char* camIP = "ip from cam_wifi_http_server serial";

TFT_eSPI tft = TFT_eSPI();
uint8_t* buf = NULL;

unsigned long lastTriggerTime = 0;
const unsigned long cooldown = 3000;

int imgOffsetX = 0;
int imgOffsetY = HEADER_H;

bool stoppedMode = false;
bool lastStoppedMode = false;

bool tft_output(int16_t x, int16_t y, uint16_t w, uint16_t h, uint16_t *bitmap) {
  tft.pushImage(x + imgOffsetX, y + imgOffsetY, w, h, bitmap);
  return true;
}

void setup() {
  Serial.begin(115200);

  pinMode(PIR_PIN, INPUT);
  pinMode(SWITCH_PIN, INPUT);

  tft.init();
  tft.setRotation(0);
  tft.setSwapBytes(true);
  tft.fillScreen(TFT_BLACK);

  TJpgDec.setCallback(tft_output);
  TJpgDec.setJpgScale(2);

  buf = (uint8_t*) malloc(BUF);
  if (!buf) {
    Serial.println("not enough RAM for buffer");
    while (1);
  }

  WiFi.begin(ssid, password);
  Serial.print("WiFi...");
  while (WiFi.status() != WL_CONNECTED) {
    delay(500);
    Serial.print(".");
  }
  Serial.println("\nOK!");
}

void drawHeader() {
  tft.fillRect(0, 0, tft.width(), HEADER_H, TFT_BLACK);
  tft.setTextColor(TFT_RED, TFT_BLACK);
  tft.setTextSize(2);

  String text = "Motion detected!";
  int textWidth = tft.textWidth(text);
  int x = (tft.width() - textWidth) / 2;
  tft.drawBitmap(90, 35, motion_sensor, 53, 55, 0xFFFF);

  tft.setCursor(x, 8);
  tft.println(text);
}

void drawStoppedLabel() {
  int h = 30;
  int y = tft.height() - h;

  tft.fillRect(0, y, tft.width(), h, TFT_BLACK);
  tft.setTextColor(TFT_YELLOW, TFT_BLACK);
  tft.setTextSize(2);

  String text = "STOPPED";
  int textWidth = tft.textWidth(text);
  int x = (tft.width() - textWidth) / 2;

  tft.setCursor(x + 2, y + 8);
  tft.println(text);
  tft.drawBitmap(68, 300, paused, 8, 10, TFT_YELLOW);
}

void clearStoppedLabel() {
  int h = 30;
  int y = tft.height() - h;
  tft.fillRect(0, y, tft.width(), h, TFT_BLACK);
}

void getFrame() {
  HTTPClient http;
  String url = String("http://") + camIP + "/capture";

  http.begin(url);
  int httpCode = http.GET();
  Serial.println(httpCode);

  if (httpCode == 200) {
    WiFiClient *stream = http.getStreamPtr();
    int index = 0;
    unsigned long start = millis();

    while (http.connected() && millis() - start < 300) {
      int available = stream->available();
      if (available) {
        int read = stream->readBytes(buf + index, available);
        index += read;
        if (index >= BUF) break;
      }
    }

    Serial.print("JPG size: ");
    Serial.println(index);

    if (index > 0) {
      uint16_t jpgW = 0, jpgH = 0;
      TJpgDec.getJpgSize(&jpgW, &jpgH, buf, index);

      jpgW /= JPG_SCALE;
      jpgH /= JPG_SCALE;

      int availableH = tft.height() - HEADER_H;
      imgOffsetX = (tft.width() - jpgW) / 2;
      imgOffsetY = HEADER_H + (availableH - jpgH) / 2;

      if (imgOffsetX < 0) imgOffsetX = 0;
      if (imgOffsetY < HEADER_H) imgOffsetY = HEADER_H;

      tft.fillScreen(TFT_BLACK);
      drawHeader();

      TJpgDec.drawJpg(0, 0, buf, index);

      if (stoppedMode) {
        drawStoppedLabel();
      }
    }
  }
  http.end();
}

void loop() {
  static bool lastState = LOW;
  bool currentState = digitalRead(PIR_PIN);
  unsigned long now = millis();

  stoppedMode = (digitalRead(SWITCH_PIN) == LOW);

  if (stoppedMode != lastStoppedMode) {
    if (stoppedMode) {
      Serial.println("STOPPED MODE");
      drawStoppedLabel();
    } else {
      Serial.println("RESUME MODE");
      clearStoppedLabel();
    }
    lastStoppedMode = stoppedMode;
  }

  if (stoppedMode) {
    delay(100);
    return;
  }

  if (currentState == HIGH && lastState == LOW && (now - lastTriggerTime > cooldown)) {
    Serial.println("Motion detected!");
    getFrame();
    lastTriggerTime = now;
  }

  lastState = currentState;
  delay(50);
}
